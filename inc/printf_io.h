
/*
    C Type Printf Implementation

    Created on: July 26, 2023

    Author: Coskun ERGAN
*/

#pragma once
#include <stdio.h>
#include <zephyr/devicetree.h>
#include <zephyr/drivers/gpio.h>
#include <zephyr/kernel.h>

#include <zpp.hpp>
#include <zpp/timer.hpp>
#include <chrono>
#include <zpp/thread.hpp>
#include <zpp/fmt.hpp>

namespace device_printf
{
    using namespace zpp;
    using namespace std::chrono;

    extern "C" void __stdout_hook_install(int (*fn)(int));
    extern "C" int printf_io_write(int c);

    static const struct gpio_dt_spec lcd_bl =
        GPIO_DT_SPEC_GET_OR(DT_NODELABEL(lcd_bl), gpios,
                            {
                                0
                            });
    static const struct gpio_dt_spec lcd_rst =
        GPIO_DT_SPEC_GET_OR(DT_NODELABEL(lcd_rst), gpios,
                            {
                                0
                            });
    static const struct gpio_dt_spec lcd_enb =
        GPIO_DT_SPEC_GET_OR(DT_NODELABEL(lcd_enb), gpios,
                            {
                                0
                            });
    static const struct gpio_dt_spec lcd_cmd =
        GPIO_DT_SPEC_GET_OR(DT_NODELABEL(lcd_cmd), gpios,
                            {
                                0
                            });
    static const struct gpio_dt_spec lcd_dta =
        GPIO_DT_SPEC_GET_OR(DT_NODELABEL(lcd_dta), gpios,
                            {
                                0
                            });
    static const struct gpio_dt_spec lcd_clk =
        GPIO_DT_SPEC_GET_OR(DT_NODELABEL(lcd_clk), gpios,
                            {
                                0
                            });

    const uint8_t init_params[] =
    {
        0xF1, 0x0F, 0xF8, 0x01, 0x06, 0xF0, 0x00, 0x2D, 0xA8, 0xA3, 0x81, 0x8, 0xFF
    };

    const uint8_t char_table[111][6] =
    {
        0x00, 0x00, 0x00, 0x00, 0x00, 0x00, // SPACE
        0x00, 0x00, 0x5F, 0x00, 0x00, 0x00, // !
        0x00, 0x03, 0x00, 0x03, 0x00, 0x00, // "
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        0x38, 0x38, 0xFE, 0x7C, 0x38, 0x10  //>
    };

    void timer_callback(timer_base *t) noexcept
    {
        gpio_pin_set_dt(&lcd_bl, false);
    }

    auto g_t = make_timer(timer_callback);

    class printf_io
    {
    public:
        printf_io()
        {
            __stdout_hook_install(printf_io_write);
            setvbuf(stdout, NULL, _IONBF, 0);
            gpio_pin_configure_dt(&lcd_rst, GPIO_OUTPUT_INACTIVE);
            gpio_pin_configure_dt(&lcd_bl, GPIO_OUTPUT_INACTIVE);
            gpio_pin_configure_dt(&lcd_enb, GPIO_OUTPUT_INACTIVE);
            gpio_pin_configure_dt(&lcd_cmd, GPIO_OUTPUT_INACTIVE);
            gpio_pin_configure_dt(&lcd_dta, GPIO_OUTPUT_INACTIVE);
            gpio_pin_configure_dt(&lcd_clk, GPIO_OUTPUT_INACTIVE);
            volatile uint8_t i = 0;
            gpio_pin_set_dt(&lcd_rst, true);
            while(--i);
            gpio_pin_set_dt(&lcd_enb, true);
            gpio_pin_set_dt(&lcd_rst, false);
            while(--i);
            gpio_pin_set_dt(&lcd_cmd, false);
            i = 0;
            do
            {
                io_send(init_params[i++]);
            }
            while(i <= sizeof(init_params));
            io_send(0xAF);
            io_send(0xB0);
            for(uint8_t i = 0; i < 16; i++)
            {
                gpio_pin_set_dt(&lcd_cmd, false);
                io_send(i);
                io_send(0x10);
                gpio_pin_set_dt(&lcd_cmd, true);
                io_send(0x00);
            }
            gpio_pin_set_dt(&lcd_cmd, false);
            io_send(0xB8);
            for(i = 0; i < 96; i++)
            {
                gpio_pin_set_dt(&lcd_cmd, false);
                io_send(i & 0xF);
                io_send((i >> 4) | 0x10);
                gpio_pin_set_dt(&lcd_cmd, true);
                io_send(0x00);
            }
            gpio_pin_set_dt(&lcd_cmd, false);
            io_send(0xB0);
            io_send(0x00);
            io_send(0x11);
            gpio_pin_set_dt(&lcd_cmd, true);
            ch_count = 0;
        }
        ~printf_io() = default;
        printf_io(printf_io &&) = delete;
        printf_io &operator=(printf_io &&) = delete;
        printf_io(const printf_io &) = delete;
        printf_io &operator=(const printf_io &) = delete;

        int io_putchar(int ch)
        {
            if((ch == '\r') || (ch_count > 25))
            {
                if(ch == '\r')
                {
                    ch_count = 0;
                }
                gpio_pin_set_dt(&lcd_cmd, false);
                io_send(0xB0);
                io_send(0x00);
                io_send(0x11);
                gpio_pin_set_dt(&lcd_cmd, true);

            }
            else if(ch == '\n')
            {
                if(ch_count < 14)
                {
                    ch_count = 14;
                    gpio_pin_set_dt(&lcd_cmd, false);
                    io_send(0xB1);
                    io_send(0x00);
                    io_send(0x11);
                    gpio_pin_set_dt(&lcd_cmd, true);
                }
            }
            else
            {
                if(++ch_count == 14)
                {
                    io_send(0);
                    io_send(0);
                    gpio_pin_set_dt(&lcd_cmd, false);
                    io_send(0xB1);
                    io_send(0x00);
                    io_send(0x11);
                    gpio_pin_set_dt(&lcd_cmd, true);
                }
                uint8_t temp = ch - 0x20;
                for(uint8_t i = 0; i < 6; i++)
                {
                    io_send(char_table[temp][i]);
                }
            }
            return ch;
        }

        void turn_off_bl_enable(milliseconds ms = 3000ms)
        {
            gpio_pin_set_dt(&lcd_bl, true);
            g_t.start(ms);
        }

    private:
        uint8_t ch_count;
        
        void io_send(uint8_t byte)
        {
            for(uint8_t i = 0; i < 8; i++)
            {
                gpio_pin_set_dt(&lcd_clk, false);
                if((byte & 0x80) == 0x80)
                {
                    gpio_pin_set_dt(&lcd_dta, true);
                }
                else
                {
                    gpio_pin_set_dt(&lcd_dta, false);
                }
                byte <<= 1;
                gpio_pin_set_dt(&lcd_clk, true);
            }
        }
    };

    printf_io printf_io;
    mutex m;

    extern "C" int printf_io_write(int c)
    {
        lock_guard g(m);
        printf_io.io_putchar(c);
        return c;
    }
}
